## conf/layer.conf
```bitbake
# We have a conf and classes directory, append to BBPATH
BBPATH .= ":${LAYERDIR}"

# We have a recipes directory, add to BBFILES
BBFILES += "${LAYERDIR}/recipes*/*/*.bb ${LAYERDIR}/recipes*/*/*.bbappend ${LAYERDIR}/images/*.bb"

BBFILE_COLLECTIONS += "meta-builderbot"
BBFILE_PATTERN_meta-builderbot := "^${LAYERDIR}/"
BBFILE_PRIORITY_meta-builderbot = "16"

LAYERSERIES_COMPAT_meta-builderbot = "sumo"
```

## conf/local.conf.sample
```bitbake
# Local configuration for meta-builderbot images
# Yocto Project 2.4 Poky distribution [rocko] branch
# This is a sysvinit system

LICENSE_FLAGS_WHITELIST = "commercial"

DISTRO_FEATURES = "ext2 usbhost ${DISTRO_FEATURES_LIBC}"

PREFERRED_PROVIDER_jpeg = "libjpeg-turbo"

PREFERRED_PROVIDER_udev = "eudev"

MACHINE = "builderbot"

KERNEL_DEVICETREE = "omap4-duovero-builderbot.dtb"

DISTRO = "poky"

PACKAGE_CLASSES = "package_ipk"

# i686 or x86_64
SDKMACHINE = "x86_64"

# enable password-less login as root
EXTRA_IMAGE_FEATURES = "debug-tweaks"

USER_CLASSES = "image-mklibs image-prelink"

PATCHRESOLVE = "noop"

RM_OLD_IMAGE = "1"

#INHERIT += "rm_work"

CONF_VERSION = "1"
```

## conf/machine/builderbot.conf
```bitbake
#@TYPE: Machine
#@NAME: BuilderBot
#@DESCRIPTION: Machine configuration for the IRIDIA BuilderBot

SOC_FAMILY = "omap4"
TARGET_ARCH = "arm"

DEFAULTTUNE ?= "cortexa9hf-neon"

require conf/machine/include/soc-family.inc
require conf/machine/include/tune-cortexa9.inc

PREFERRED_PROVIDER_virtual/kernel = "linux-stable"
PREFERRED_VERSION_linux-stable = "4.16.5"
KERNEL_IMAGETYPE = "zImage"

PREFERRED_PROVIDER_virtual/bootloader = "u-boot"
PREFERRED_PROVIDER_u-boot = "u-boot"

UBOOT_ENTRYPOINT = "0x80008000"
UBOOT_LOADADDRESS = "0x80008000"
UBOOT_MACHINE = "duovero_config"
BOOTENV_SIZE = "0x20000"

EXTRA_IMAGEDEPENDS += "u-boot"

SERIAL_CONSOLE = "115200 ttyO2"

IMAGE_FSTYPES = "tar.xz"

MACHINE_ESSENTIAL_EXTRA_RDEPENDS = "kernel-image kernel-devicetree"

#MACHINE_ESSENTIAL_EXTRA_RRECOMMENDS = "kernel-module-bb-avr-uptime"
#MACHINE_ESSENTIAL_EXTRA_RRECOMMENDS = "hello-mod"

MACHINE_FEATURES = "ext2 serial usbhost vfat"
```
